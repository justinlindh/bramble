## components/ui_graphics/Kconfig
```kconfig
menu "Bramble Graphical UI"
    depends on BRAMBLE_BOARD_TDECK_PLUS

    config BRAMBLE_UI_GRAPHICAL
        bool "Enable LVGL graphical UI (T-Deck Plus)"
        default y if BRAMBLE_BOARD_TDECK_PLUS
        help
            Enables the LVGL-based graphical UI for devices with
            color LCD and touch support. Disables the text-based UI.

    config BRAMBLE_TOUCH_ENABLED
        bool "Enable GT911 touchscreen"
        default y if BRAMBLE_UI_GRAPHICAL
        depends on BRAMBLE_UI_GRAPHICAL
        help
            Enables the GT911 capacitive touch controller driver.

endmenu
```

## components/wifi/Kconfig
```kconfig
menu "Bramble WiFi"

config BRAMBLE_WIFI_ENABLED
    bool "Enable WiFi"
    default y

config BRAMBLE_WIFI_SSID
    string "WiFi SSID (station mode)"
    default ""
    depends on BRAMBLE_WIFI_ENABLED

config BRAMBLE_WIFI_PASSWORD
    string "WiFi Password (station mode)"
    default ""
    depends on BRAMBLE_WIFI_ENABLED

config BRAMBLE_WIFI_AP_SSID
    string "WiFi AP SSID (fallback)"
    default "Bramble"
    depends on BRAMBLE_WIFI_ENABLED

config BRAMBLE_WIFI_AP_PASSWORD
    string "WiFi AP Password override (empty = derive per device)"
    default ""
    depends on BRAMBLE_WIFI_ENABLED
    help
      Leave this EMPTY (the default) and each node derives its own WPA2
      password from its identity key: unique per device, stable across
      reboots and reflashes, and not knowable from anything the node puts
      on the air. The node shows it on its display in AP mode and prints
      it from the serial console with "wifi status", which is how the
      operator learns it.

      Set a non-empty value only to pin one fixed password across a fleet.
      It must be 8 to 63 characters (the WPA2-PSK bounds) or AP mode
      refuses to start. It is compiled into the image, so treat it as a
      shared secret and never commit a real one to a public tree.

config BRAMBLE_WIFI_STA_TIMEOUT_S
    int "Station connect timeout (seconds)"
    default 10
    depends on BRAMBLE_WIFI_ENABLED

endmenu
```

## main/Kconfig.projbuild
```kconfig
menu "Bramble Configuration"

    choice BRAMBLE_BOARD
        prompt "Board selection"
        default BRAMBLE_BOARD_HELTEC_V3

        config BRAMBLE_BOARD_HELTEC_V3
            bool "Heltec WiFi LoRa 32 V3 (SX1262)"

        config BRAMBLE_BOARD_HELTEC_V4
            bool "Heltec WiFi LoRa 32 V4 (ESP32-S3 + SX1262 + optional GNSS)"

        config BRAMBLE_BOARD_TDECK_PLUS
            bool "LILYGO T-Deck Plus (ESP32-S3 + SX1262 + GPS + Keyboard)"

        config BRAMBLE_BOARD_TTGO_LORA32
            bool "TTGO LoRa32 (SX1276)"

        config BRAMBLE_BOARD_CUSTOM
            bool "Custom board"
    endchoice

    config BRAMBLE_TX_POWER
        int "TX power (dBm)"
        default 17
        range 2 22

    choice BRAMBLE_RADIO_PROFILE
        prompt "Radio profile"
        default BRAMBLE_PROFILE_LONG_RANGE

        config BRAMBLE_PROFILE_LONG_RANGE
            bool "Long range (SF10, 125kHz)"

        config BRAMBLE_PROFILE_BALANCED
            bool "Balanced (SF8, 250kHz)"

        config BRAMBLE_PROFILE_FAST
            bool "Fast (SF7, 500kHz)"
    endchoice

    choice BRAMBLE_REGION
        prompt "Bramble frequency region"
        default BRAMBLE_REGION_US915
        help
            Select the regulatory region for LoRa radio operation.

        config BRAMBLE_REGION_US915
            bool "US915 (FCC 902-928 MHz)"

        config BRAMBLE_REGION_EU868
            bool "EU868 (ETSI 863-870 MHz)"

        config BRAMBLE_REGION_AU915
            bool "AU915 (ACMA 915-928 MHz)"

    endchoice

    config BRAMBLE_OTA_ALLOW_HTTP
        bool "Allow plain-HTTP OTA downloads (dev only)"
        default n
        help
            Compile in the plain-HTTP OTA download path so a LAN dev server
            (python3 -m http.server) can feed the device. Image signature
            verification still applies; only transport confidentiality and
            server authentication are lost. Never enable on release builds.

    menu "Bramble Message Persistence"
        config BRAMBLE_MSG_PERSIST_ENABLED
            bool "Enable message persistence to SPIFFS"
            default y

        config BRAMBLE_MSG_PERSIST_MAX
            int "Maximum persisted messages"
            default 200
            range 50 1000
            depends on BRAMBLE_MSG_PERSIST_ENABLED

        config BRAMBLE_MSG_PERSIST_ROLLOVER_KEEP_PCT
            int "Percentage of messages to keep on rollover"
            default 75
            range 50 90
            depends on BRAMBLE_MSG_PERSIST_ENABLED
    endmenu

endmenu
```
